#include <avr/pgmspace.h>
#include "FastLED.h"

#define NUM_LEDS 15

#define DATA_PIN_FIRST 12
#define DATA_PIN_SECOND 5
#define DATA_PIN_THIRD 11
#define DATA_PIN_FOURTH 3

#define HALL_PIN 2

CRGB leds0[NUM_LEDS];
CRGB leds90[NUM_LEDS];
CRGB leds180[NUM_LEDS];
CRGB leds270[NUM_LEDS];

volatile boolean turning = false;
volatile uint32_t revTime = 0;              //time at which hall switch got the signal
volatile uint32_t lastRevTime = 0;         
uint32_t currentAngle = 0;
uint32_t revPeriod = 0;      //time between revolutions
const uint16_t maxAngle = 0xFFFF;
const uint16_t angleOffset = 25486; //to get correct orientation (52792 should be good for riding)

const uint16_t timeOutInterval = 3000;
const uint16_t timeBetweenFrames = 35;
uint32_t mainTime, lastFrameTime, drawTime = 0;
const uint8_t imageWidth = 248;
uint8_t currentFrame = 0;
uint16_t sizeOfImage = 8680; // = 248*35
uint8_t sat, val;
int32_t x, y;
float zoomX = 1.15;
float zoomY = 1.15;

const byte imageProGlove[] PROGMEM  = {
 0, 0, 0, 0, 0, 0, 0, 0, 0, 0, 0, 0,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 0
};

void setup() {
  FastLED.addLeds<WS2812B, DATA_PIN_FIRST, GRB>(leds0, NUM_LEDS);
  FastLED.addLeds<WS2812B, DATA_PIN_SECOND, GRB>(leds90, NUM_LEDS);
  FastLED.addLeds<WS2812B, DATA_PIN_THIRD, GRB>(leds180, NUM_LEDS);
  FastLED.addLeds<WS2812B, DATA_PIN_FOURTH, GRB>(leds270, NUM_LEDS);
  pinMode(HALL_PIN, INPUT_PULLUP);
  attachInterrupt(digitalPinToInterrupt(HALL_PIN), hallSignal, FALLING);
}

void hallSignal() {
  lastRevTime = revTime;
  revTime = millis();
  turning = true;
}

byte mapPixelToLed(int led) {
  x = 18 + ((int)(((cos8(currentAngle >> 8) - 128) * (led  + 2.333) * zoomX)) >> 7);
  y = 18 - ((int)(((sin8(currentAngle >> 8) - 128) * (led  + 2.333) * zoomY)) >> 7);
  y = constrain(y, 1, 35);
  return (pgm_read_byte(&imageProGlove[(((y - 1) * imageWidth + (x - 1)) + currentFrame ) % sizeOfImage]));
}

void setStrip(CRGB strip[NUM_LEDS], uint16_t stripAngle) {
  currentAngle = ((drawTime * maxAngle) / revPeriod) + stripAngle + angleOffset;
  currentAngle = maxAngle - (currentAngle % maxAngle);
  for (int i = 0; i < NUM_LEDS; i++) {
    byte pixelValue = mapPixelToLed(i);
    if ((currentFrame + x) % imageWidth < 98) {
      sat = pixelValue;
      val = max(40, sat);
    }
    else {
      sat = 0;
      val = pixelValue > 0 ? 0 : 40;
    }
    strip[i].setHSV(11, sat, val);
  }
}

void loop() {
  mainTime = millis();
  revPeriod = revTime - lastRevTime;
  drawTime = mainTime - revTime;
  if (mainTime - revTime > timeOutInterval) {        //timeout(stop detection)
    turning = false;
  }
  if (mainTime - lastFrameTime > timeBetweenFrames) {     //change between frames
    currentFrame = (currentFrame + 1) % imageWidth;
    lastFrameTime = mainTime;
  }
  if (turning) {   
    //Set First Strip (0°)
    setStrip(leds0, 8192);   
    //Set Second Strip (90°)
    setStrip(leds90, 24576);   
    //Set Third Strip (180°)
    setStrip(leds180, 40960);   
    //Set Fourth Strip (270°)
    setStrip(leds270, 57344);   
  }
  //turn off all strips while not turning
  else if (!turning) {
    for (int i = 0; i < NUM_LEDS; i++) {
      leds0[i].setHSV(0, 0, 0);
      leds90[i].setHSV(0, 0, 0);
      leds180[i].setHSV(0, 0, 0);
      leds270[i].setHSV(0, 0, 0);
    }
  }
  FastLED.show();
}

